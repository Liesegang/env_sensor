## card/firmware/boards/liesegang/env_sensor_card/Kconfig.env_sensor_card
```kconfig
config BOARD_ENV_SENSOR_CARD
	select SOC_NRF54L15_CPUAPP if BOARD_ENV_SENSOR_CARD_NRF54L15_CPUAPP
```

## card/firmware/boards/liesegang/env_sensor_card/board.yml
```yaml
board:
  name: env_sensor_card
  full_name: Card environment sensor v2 (ES4L15BA1)
  vendor: liesegang
  socs:
    - name: nrf54l15
```

## outdoor/firmware/boards/liesegang/env_sensor_outdoor/Kconfig.env_sensor_outdoor
```kconfig
config BOARD_ENV_SENSOR_OUTDOOR
	select SOC_NRF54L15_CPUAPP if BOARD_ENV_SENSOR_OUTDOOR_NRF54L15_CPUAPP
```

## outdoor/firmware/boards/liesegang/env_sensor_outdoor/board.yml
```yaml
board:
  name: env_sensor_outdoor
  full_name: Outdoor environment sensor (ES4L15BA1)
  vendor: liesegang
  socs:
    - name: nrf54l15
```

## outdoor/firmware/driver/as3935/Kconfig
```kconfig
config APP_AS3935
	bool "Read the AS3935 lightning sensor"
	depends on APP_SENSOR_READ
	default n
	help
	  Enable after connecting the AS3935. Check the module's address straps.
	  The current board has no MCU IRQ connection; reads poll the event register.
```

## outdoor/firmware/driver/bmv080/Kconfig
```kconfig
config APP_BMV080
	bool "Read the BMV080 using the official Bosch SDK"
	depends on APP_SENSOR_READ
	default n
	help
	  Requires the Bosch BMV080 SDK headers and ARM Cortex-M33 libraries.
	  Use the soft-float build with the board's default CONFIG_FPU=n.
	  The SDK requires a 10 KiB stack; set MAIN_STACK_SIZE to at least 12288.

if APP_BMV080

config BMV080_SDK_INCLUDE_DIR
	string "Directory containing bmv080.h and bmv080_defs.h"
	default ""

config BMV080_SDK_DRIVER_LIBRARY
	string "Full path to the Cortex-M33 lib_bmv080.a"
	default ""

config BMV080_SDK_POSTPROCESSOR_LIBRARY
	string "Full path to the matching lib_postProcessor.a"
	default ""

endif
```

## outdoor/firmware/driver/buzzer/Kconfig
```kconfig
menu "Buzzer driver"

config BUZZER_FREQUENCY_HZ
	int "Buzzer pulse frequency (Hz)"
	range 500 4000
	default 2000

config BUZZER_DUTY_PERMILLE
	int "Buzzer duty in thousandths (500 = 50%)"
	range 1 500
	default 500

endmenu
```

## shared/firmware/driver/sfa40/Kconfig
```kconfig
config APP_SFA40
	bool "Read the SFA40 formaldehyde sensor"
	depends on APP_SENSOR_READ
	default n
	help
	  Enable after connecting the SFA40 at I2C address 0x5d.
	  Reports HCHO, humidity, temperature, raw values and readiness status.
```

## shared/firmware/telemetry/Kconfig
```kconfig
config ENV_TELEMETRY_SECURE
	bool "Authenticated Secure Connections telemetry with persistent owner bond"
	depends on BT_PERIPHERAL && BT_SMP_SC_ONLY && BT_SETTINGS
	depends on BT_SMP_APP_PAIRING_ACCEPT && BT_BONDING_REQUIRED
	depends on BT_APP_PASSKEY
	default n
	help
	  Require LE security level 4 for telemetry/clock/CCC, show a random
	  passkey, persist one owner's bond and reload it after bt_enable.
	  Applications must provide an asynchronous passkey display and a
	  physically authorized re-pair operation.
```
